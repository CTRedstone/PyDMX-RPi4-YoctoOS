## meta-pydmx/conf/layer.conf
```bitbake
# We have a conf and classes directory, add to BBPATH
BBPATH .= ":${LAYERDIR}"

# We have recipes-* directories, add to BBFILES
BBFILES += "${LAYERDIR}/recipes-*/*/*.bb \
            ${LAYERDIR}/recipes-*/*/*.bbappend"

BBFILE_COLLECTIONS += "meta-pydmx"
BBFILE_PATTERN_meta-pydmx = "^${LAYERDIR}/"
BBFILE_PRIORITY_meta-pydmx = "6"

LAYERDEPENDS_meta-pydmx = "core"
LAYERSERIES_COMPAT_meta-pydmx = "scarthgap"

PREFERRED_VERSION_protobuf = "3.21.%"
PREFERRED_VERSION_protobuf-native = "3.21.%"
```
